## boards/common/nucleo/Kconfig
```kconfig
# Copyright (c) 2020 HAW Hamburg
#
# This file is subject to the terms and conditions of the GNU Lesser
# General Public License v2.1. See the file LICENSE in the top level
# directory for more details.
#

config BOARD_COMMON_NUCLEO
    bool

config MOD_BOARDS_COMMON_NUCLEO
    bool
    default y
    depends on BOARD_COMMON_NUCLEO
    depends on TEST_KCONFIG
```

## boards/common/nucleo144/Kconfig
```kconfig
# Copyright (c) 2020 Inria
#
# This file is subject to the terms and conditions of the GNU Lesser
# General Public License v2.1. See the file LICENSE in the top level
# directory for more details.
#

config BOARD_COMMON_NUCLEO144
    bool
    select HAS_ARDUINO
    select BOARD_COMMON_NUCLEO

config MOD_NUCLEO144_COMMON
    default y
    depends on BOARD_COMMON_NUCLEO144
    depends on TEST_KCONFIG

source "$(RIOTBOARD)/common/nucleo/Kconfig"
```

## boards/common/silabs/Kconfig
```kconfig
# Copyright (c) 2020 HAW Hamburg
#
# This file is subject to the terms and conditions of the GNU Lesser
# General Public License v2.1. See the file LICENSE in the top level
# directory for more details.

config BOARD_COMMON_SILABS
    bool
    select HAS_ARDUINO
    select HAS_RIOTBOOT
    select MOD_BOARDS_COMMON_SILABS

config MOD_BOARDS_COMMON_SILABS
    bool
    depends on BOARD_COMMON_SILABS
    depends on TEST_KCONFIG

if BOARD_COMMON_SILABS

rsource "drivers/aem/Kconfig"
rsource "drivers/bc/Kconfig"
rsource "drivers/pic/Kconfig"

endif # BOARD_COMMON_SILABS
```

## cpu/efm32/Kconfig
```kconfig
# Copyright (c) 2020 HAW Hamburg
#
# This file is subject to the terms and conditions of the GNU Lesser
# General Public License v2.1. See the file LICENSE in the top level
# directory for more details.

config CPU_COMMON_EFM32
    bool
    select HAS_ARCH_EFM32
    select HAS_CORTEXM_MPU
    select HAS_CPU_EFM32
    select HAS_PERIPH_CPUID
    select HAS_PERIPH_FLASHPAGE
    select HAS_PERIPH_FLASHPAGE_RAW
    select HAS_PERIPH_GPIO
    select HAS_PERIPH_GPIO_IRQ
    select PACK_GECKO_SDK

## Definition of specific features
config HAS_ARCH_EFM32
    bool
    help
        Indicates that the 'efm32' architecture is being used.

config HAS_CPU_EFM32
    bool
    help
        Indicates that the CPU being used is an EFM32.

## Common CPU symbols
config CPU
    default "efm32" if CPU_COMMON_EFM32

config MOD_PERIPH_HASH_SHA1
    depends on CPU_COMMON_EFM32
    select HAVE_OWN_SHA1_CTX

config MOD_PERIPH_HASH_SHA256
    depends on CPU_COMMON_EFM32
    select HAVE_OWN_SHA256_CTX

config EFM32_AES_ECB_NONBLOCKING
    bool "Use parallel AES ECB enctryption"
    depends on MOD_PERIPH_CRYPTO_AES_ECB

orsource "families/*/Kconfig"
source "$(RIOTCPU)/cortexm_common/Kconfig"
```

## cpu/kinetis/mmcau_lib/Kconfig
```kconfig
# Copyright (c) 2020 HAW Hamburg
#
# This file is subject to the terms and conditions of the GNU Lesser
# General Public License v2.1. See the file LICENSE in the top level
# directory for more details.
#

config MOD_LIB_MMCAU
    bool
    default y if MOD_PERIPH_HASH_SHA1 || MOD_PERIPH_HASH_SHA256 || MOD_PERIPH_CRYPTO_AES
    depends on CPU_COMMON_KINETIS
    depends on TEST_KCONFIG
    select HAVE_OWN_CIPHER_CONTEXT_T
    help
        Library for crypto hardware accelerated cryptographic implementations on
        Kinetis CPUs.
```

## cpu/kinetis/periph/Kconfig
```kconfig
# Copyright (c) 2020 HAW Hamburg
#
# This file is subject to the terms and conditions of the GNU Lesser
# General Public License v2.1. See the file LICENSE in the top level
# directory for more details.
#

if CPU_COMMON_KINETIS && TEST_KCONFIG

config MOD_PERIPH_ICS
    bool "Kinetis Internal Clock Source controller (ICS)"
    default y
    depends on HAS_PERIPH_ICS

config MOD_PERIPH_MCG
    bool "Kinetis Multipurpose Clock Generator (MCG)"
    default y
    depends on HAS_PERIPH_MCG

config MOD_PERIPH_WDOG
    bool "Kinetis Watchdog peripheral support"
    default y

config MOD_PERIPH_CRYPTO_AES
    depends on CPU_COMMON_KINETIS
    select HAVE_OWN_CIPHER_CONTEXT_T

config MOD_PERIPH_HASH_SHA1
    depends on CPU_COMMON_KINETIS
    select HAVE_OWN_SHA1_CTX

config MOD_PERIPH_HASH_SHA256
    depends on CPU_COMMON_KINETIS
    select HAVE_OWN_SHA256_CTX

endif # CPU_COMMON_KINETIS && TEST_KCONFIG
```

## cpu/nrf52/Kconfig
```kconfig
# Copyright (c) 2020 HAW Hamburg
#
# This file is subject to the terms and conditions of the GNU Lesser
# General Public License v2.1. See the file LICENSE in the top level
# directory for more details.

config CPU_FAM_NRF52
    bool
    select CPU_CORE_CORTEX_M4F
    select CPU_COMMON_NRF5X
# The ADC does not depend on any board configuration, so always available
    select HAS_PERIPH_ADC
# So far, NimBLE netif does not support nrf51 platforms, so we use a dedicated
# feature to mark this
    select HAS_BLE_NIMBLE_NETIF
    select HAS_CORTEXM_MPU
    select HAS_CPU_NRF52
    select HAS_PERIPH_CRYPTO_AES
    select HAS_PERIPH_CRYPTO_AES_ECB
    select HAS_PERIPH_CRYPTO_AES_CTR
    select HAS_PERIPH_CRYPTO_AES_CBC
    select HAS_HW_HASH_SHA1
    select HAS_HW_HASH_SHA256
    select HAS_PERIPH_I2C_RECONFIGURE

## CPU Models
config CPU_MODEL_NRF52832XXAA
    bool
    select CPU_FAM_NRF52
    select HAS_BLE_NORDIC_SOFTDEVICE

config CPU_MODEL_NRF52840XXAA
    bool
    select CPU_FAM_NRF52

## CPU common symbols
config CPU_FAM
    default "nrf52" if CPU_FAM_NRF52

config CPU_MODEL
    default "nrf52832xxaa" if CPU_MODEL_NRF52832XXAA
    default "nrf52840xxaa" if CPU_MODEL_NRF52840XXAA

config CPU
    default "nrf52" if CPU_FAM_NRF52

## Definition of specific features
config HAS_CPU_NRF52
    bool
    help
        Indicates that the current cpu is 'nrf52'.

## The crypto implementations define their own structure
config MOD_PERIPH_CRYPTO_AES
    depends on HAS_CPU_NRF52
    select HAVE_OWN_CIPHER_CONTEXT_T

config MOD_PERIPH_CRYPTO_AES_CBC
    depends on HAS_CPU_NRF52
    select HAVE_OWN_CIPHER_CONTEXT_T

config MOD_PERIPH_CRYPTO_AES_CTR
    depends on HAS_CPU_NRF52
    select HAVE_OWN_CIPHER_CONTEXT_T

config MOD_PERIPH_CRYPTO_AES_ECB
    depends on HAS_CPU_NRF52
    select HAVE_OWN_CIPHER_CONTEXT_T

config MOD_PERIPH_HASH_SHA1
    depends on HAS_CPU_NRF52
    select HAVE_OWN_SHA1_CTX

config MOD_PERIPH_HASH_SHA256
    depends on HAS_CPU_NRF52
    select HAVE_OWN_SHA256_CTX
    select HAVE_OWN_HMAC_CTX

rsource "cryptocell_lib/Kconfig"

source "$(RIOTCPU)/nrf5x_common/Kconfig"
```

## pkg/cryptoauthlib/Kconfig
```kconfig
# Copyright (c) 2020 HAW Hamburg
#
# This file is subject to the terms and conditions of the GNU Lesser
# General Public License v2.1. See the file LICENSE in the top level
# directory for more details.
#

config PACK_CRYPTOAUTHLIB
    bool "Microchip CryptoAuth library"
    select MOD_CRYPTOAUTHLIB_CONTRIB
    depends on HAS_PERIPH_I2C
    select MOD_PERIPH_I2C
    select MOD_XTIMER
    imply MOD_PERIPH_I2C_RECONFIGURE

choice CRYPTO_AES_IMPLEMENTATION
    default MOD_CRYPTOAUTHLIB_CRYPTO_AES

config MOD_CRYPTOAUTHLIB_CRYPTO_AES
    bool "Microchip CryptoAuth library"
    depends on PACK_CRYPTOAUTHLIB
    select MOD_CRYPTOAUTHLIB_CRYPTO

endchoice


choice CRYPTO_MODE_AES_CTR_IMPLEMENTATION
    default MOD_CRYPTOAUTHLIB_CRYPTO_AES_CTR
config MOD_CRYPTOAUTHLIB_CRYPTO_AES_CTR
    bool "Microchip CryptoAuth library"
    depends on PACK_CRYPTOAUTHLIB
    select MOD_CRYPTOAUTHLIB_CRYPTO

endchoice


choice CRYPTO_MODE_AES_CBC_IMPLEMENTATION
    default MOD_CRYPTOAUTHLIB_CRYPTO_AES_CBC

config MOD_CRYPTOAUTHLIB_CRYPTO_AES_CBC
    bool "Microchip CryptoAuth library"
    depends on PACK_CRYPTOAUTHLIB
    select MOD_CRYPTOAUTHLIB_CRYPTO

endchoice


choice CRYPTO_MODE_AES_ECB_IMPLEMENTATION

config MOD_CRYPTOAUTHLIB_CRYPTO_AES_ECB
    bool "Microchip CryptoAuth library"
    depends on PACK_CRYPTOAUTHLIB
    select MOD_CRYPTOAUTHLIB_CRYPTO

endchoice

choice HASHES_SHA1_IMPLEMENTATION
    default MOD_CRYPTOAUTHLIB_HASHES_SHA1

config MOD_CRYPTOAUTHLIB_HASHES_SHA1
    bool "Microchip CryptoAuth library"
    depends on PACK_CRYPTOAUTHLIB
    select MOD_CRYPTOAUTHLIB_HASHES
    select HAVE_OWN_SHA1_CTX

endchoice

choice HASHES_SHA256_IMPLEMENTATION
    default MOD_CRYPTOAUTHLIB_HASHES_SHA256

config MOD_CRYPTOAUTHLIB_HASHES_SHA256
    bool "Microchip CryptoAuth library"
    depends on PACK_CRYPTOAUTHLIB
    select MOD_CRYPTOAUTHLIB_HASHES
    select HAVE_OWN_SHA256_CTX
    select HAVE_OWN_HMAC_CTX

endchoice

config MOD_CRYPTOAUTHLIB_CRYPTO
    bool
    select HAVE_OWN_CIPHER_CONTEXT_T
    help
        Basic module containing crypto implementations using CryptoAuth.

config MOD_CRYPTOAUTHLIB_HASHES
    bool
    help
        Basic module containing hash implementations using CryptoAuth.

rsource "contrib/Kconfig"
```

## pkg/gecko_sdk/Kconfig
```kconfig
# Copyright (c) 2020 HAW Hamburg
#
# This file is subject to the terms and conditions of the GNU Lesser
# General Public License v2.1. See the file LICENSE in the top level
# directory for more details.
#

config PACK_GECKO_SDK
    bool "EFM32 Gecko families SDK"
    depends on TEST_KCONFIG
    select MOD_GECKO_SDK_EMLIB
    select MOD_GECKO_SDK_EMLIB_EXTRA

config MOD_GECKO_SDK_EMLIB
    bool
    depends on PACK_GECKO_SDK
    depends on TEST_KCONFIG

config MOD_GECKO_SDK_EMLIB_EXTRA
    bool
    depends on PACK_GECKO_SDK
    depends on TEST_KCONFIG
```

## sys/Kconfig
```kconfig
# Copyright (c) 2019 HAW Hamburg
#
# This file is subject to the terms and conditions of the GNU Lesser
# General Public License v2.1. See the file LICENSE in the top level
# directory for more details.
#
menu "System"

rsource "auto_init/Kconfig"
rsource "crypto/Kconfig"
rsource "embunit/Kconfig"
rsource "fmt/Kconfig"
rsource "hashes/Kconfig"
rsource "isrpipe/Kconfig"
rsource "net/Kconfig"
rsource "Kconfig.newlib"
rsource "Kconfig.stdio"
rsource "luid/Kconfig"
rsource "pm_layered/Kconfig"
rsource "ps/Kconfig"
rsource "random/Kconfig"
rsource "sema/Kconfig"
rsource "shell/Kconfig"
rsource "test_utils/Kconfig"
rsource "tsrb/Kconfig"
rsource "usb/Kconfig"
rsource "xtimer/Kconfig"

config MOD_SYS
    bool
    default y
    depends on TEST_KCONFIG
    help
        System module, it serves to pull in all the rest of system modules.

endmenu # System
```

## sys/auto_init/security/Kconfig
```kconfig
# Copyright (c) 2020 HAW Hamburg
#
# This file is subject to the terms and conditions of the GNU Lesser
# General Public License v2.1. See the file LICENSE in the top level
# directory for more details.
#

config MOD_AUTO_INIT_SECURITY
    bool "Auto-initialization for security sub-systems"
    depends on MOD_AUTO_INIT
    depends on TEST_KCONFIG
```

## sys/crypto/Kconfig
```kconfig
# Copyright (c) 2020 HAW Hamburg
#
# This file is subject to the terms and conditions of the GNU Lesser
# General Public License v2.1. See the file LICENSE in the top level
# directory for more details.
#

menu "Crypto"
    depends on TEST_KCONFIG

rsource "modes/Kconfig"

menuconfig CRYPTO_AES
    bool "AES"
    select MOD_CRYPTO

if CRYPTO_AES

choice CRYPTO_AES_IMPLEMENTATION
    bool "AES implementation"
    default MOD_PERIPH_CRYPTO_AES

config MOD_PERIPH_CRYPTO_AES
    bool "Hardware accelerated"
    depends on HAS_PERIPH_CRYPTO_AES

config MOD_CRYPTO_AES
    bool "Software"

endchoice

endif # CRYPTO_AES

config MOD_CRYPTO
    bool
    help
        Base crypto module.

config HAVE_OWN_CIPHER_CONTEXT_T
    bool
    help
        Select to override the definition of cipher_context_t.

endmenu # Crypto
```

## sys/crypto/modes/Kconfig
```kconfig
# Copyright (c) 2020 HAW Hamburg
#
# This file is subject to the terms and conditions of the GNU Lesser
# General Public License v2.1. See the file LICENSE in the top level
# directory for more details.
#

menu "Crypto cipher modes"
    depends on TEST_KCONFIG

menuconfig CRYPTO_MODE_AES_CTR
    bool "AES in Counter mode (CTR)"
    depends on CRYPTO_AES
    select MOD_CRYPTO_MODE

choice CRYPTO_MODE_AES_CTR_IMPLEMENTATION
    bool "AES CTR implementation"
    default MOD_PERIPH_CRYPTO_AES_CTR
    depends on CRYPTO_MODE_AES_CTR

config MOD_CRYPTO_MODE_AES_CTR
    bool "Software implementation"
    select MOD_CRYPTO_MODE_CTR

config MOD_PERIPH_CRYPTO_AES_CTR
    bool "Hardware accelerated implementation"
    depends on HAS_PERIPH_CRYPTO_AES_CTR

endchoice

menuconfig CRYPTO_MODE_AES_CBC
    bool "AES in Cipher Block Chaining mode (CBC)"
    depends on CRYPTO_AES
    select MOD_CRYPTO_MODE

choice CRYPTO_MODE_AES_CBC_IMPLEMENTATION
    bool "AES CBC implementation"
    default MOD_PERIPH_CRYPTO_AES_CBC
    depends on CRYPTO_MODE_AES_CBC

config MOD_CRYPTO_MODE_AES_CBC
    bool "Software implementation"
    select MOD_CRYPTO_MODE_CBC

config MOD_PERIPH_CRYPTO_AES_CBC
    bool "Hardware accelerated implementation"
    depends on HAS_PERIPH_CRYPTO_AES_CBC

endchoice

menuconfig CRYPTO_MODE_AES_ECB
    bool "AES in Electronic Codebook mode (ECB)"
    depends on CRYPTO_AES
    select MOD_CRYPTO_MODE

choice CRYPTO_MODE_AES_ECB_IMPLEMENTATION
    bool "AES ECB implementation"
    default MOD_PERIPH_CRYPTO_AES_ECB
    depends on CRYPTO_MODE_AES_ECB

config MOD_CRYPTO_MODE_AES_ECB
    bool "Software implementation"
    select MOD_CRYPTO_MODE_ECB

config MOD_PERIPH_CRYPTO_AES_ECB
    bool "Hardware accelerated implementation"
    depends on HAS_PERIPH_CRYPTO_AES_ECB

endchoice

config MOD_CRYPTO_MODE_ECB
    bool
    help
        Software implementation of the Electronic Codebook crypto mode.

config MOD_CRYPTO_MODE_CBC
    bool
    help
        Software implementation of the Cipher Block Chaining crypto mode.

config MOD_CRYPTO_MODE_CTR
    bool
    help
        Software implementation of the Counter crypto mode.

config MOD_CRYPTO_MODE
    bool
    help
        Basic Crypto mode common module.

endmenu # Cipher modes
```

## sys/hashes/Kconfig
```kconfig
# Copyright (c) 2020 HAW Hamburg
#
# This file is subject to the terms and conditions of the GNU Lesser
# General Public License v2.1. See the file LICENSE in the top level
# directory for more details.
#
menu "Hashes"
    depends on TEST_KCONFIG

menuconfig HASHES_SHA1
    bool "SHA-1 hashing support"

if HASHES_SHA1

choice HASHES_SHA1_IMPLEMENTATION
    bool "SHA-1 implementation"
    default MOD_PERIPH_HASH_SHA1

config MOD_PERIPH_HASH_SHA1
    bool "Hardware accelerated"
    depends on HAS_HW_HASH_SHA1

config MOD_HASHES_SHA1
    bool "Software implemented"
    select MOD_HASHES
    select MOD_HASHES_SHA2XX_COMMON

endchoice

endif # HASHES_SHA1

menuconfig HASHES_SHA256
    bool "SHA-256"

if HASHES_SHA256

choice HASHES_SHA256_IMPLEMENTATION
    bool "SHA-256 implementation"
    default MOD_PERIPH_HASH_SHA256

config MOD_PERIPH_HASH_SHA256
    bool "Hardware accelerated"
    depends on HAS_HW_HASH_SHA256

config MOD_HASHES_SHA256
    bool "Software"
    select MOD_HASHES
    select MOD_HASHES_SHA2XX_COMMON

endchoice

endif # HASHES_SHA256

config MOD_HASHES
    bool
    help
        Base module for software implemented hashes.

config MOD_HASHES_SHA2XX_COMMON
    bool
    help
        Base module for sha2xx implementations.

config HAVE_OWN_SHA1_CTX
    bool
    help
        Select to override the definition of sha1_context.

config HAVE_OWN_SHA256_CTX
    bool
    help
        Select to override the definition of sha256_context.

config HAVE_OWN_HMAC_CTX
    bool
    help
        Select to override the definition of hmac_context_t.

endmenu # Hashes
```
